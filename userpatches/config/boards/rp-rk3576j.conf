## userpatches/kernel/archive/rockchip64-7.3/mpp-src/Kconfig
```kconfig
# SPDX-License-Identifier: (GPL-2.0+ OR MIT)

menuconfig ROCKCHIP_MPP_SERVICE
	tristate "Rockchip MPP service framework (rkmpp /dev/mpp_service)"
	depends on ARCH_ROCKCHIP
	depends on ROCKCHIP_IOMMU
	help
	  Vendor Rockchip MPP service (rk_vcodec). Provides /dev/mpp_service
	  for librockchip-mpp / ffmpeg rkmpp / mpv hwdec=rkmpp.
	  Ported from rk35xx vendor kernel for mainline/edge on RK3568.

if ROCKCHIP_MPP_SERVICE

config ROCKCHIP_MPP_PROC_FS
	bool "mpp service procfs"
	depends on PROC_FS
	default y

config ROCKCHIP_MPP_RKVDEC2
	bool "RKV decoder v2 (RK3568 rkvdec)"
	default y

config ROCKCHIP_MPP_VDPU2
	bool "VPU decoder v2"
	default y

config ROCKCHIP_MPP_VEPU2
	bool "VPU encoder v2"
	default y

config ROCKCHIP_MPP_JPGDEC
	bool "RKV JPEG decoder v1"
	default y

config ROCKCHIP_MPP_RKVENC
	bool "RKV encoder v1 (RK3568 rkvenc)"
	default y

endif
```

## userpatches/u-boot/v2026.07/board_z96a-rk3568-laptop/drm/Kconfig
```kconfig
menuconfig DRM_ROCKCHIP
	bool "Rockchip DRM Support (Z96A eDP subset from Radxa next-dev)"
	depends on VIDEO && OF_CONTROL
	select VIDEO_BRIDGE
	select PHY
	help
	  Minimal Rockchip DRM: VOP2 + Analogix eDP + combo PHY + simple panel.
	  Sourced from Radxa U-Boot next-dev-v2024.10 for RK3568 laptop eDP.
	  Mainline v2026.07 uses CONFIG_VIDEO (not CONFIG_DM_VIDEO).

if DRM_ROCKCHIP

config DRM_MEM_RESERVED_SIZE_MBYTES
	int "DRM memory pool size in MiB"
	default 16

config DRM_ROCKCHIP_VIDEO_FRAMEBUFFER
	bool "1920x1080 DRM framebuffer"
	default y
	help
	  Reserve a 1920x1080x32bpp framebuffer for Rockchip DRM vidconsole.

config ROCKCHIP_CUBIC_LUT_SIZE
	int "Cubic LUT size (0 = disabled)"
	default 0

config DRM_DP_HELPER
	bool
	default y

config DRM_ROCKCHIP_PANEL
	bool "Rockchip Panel Support"
	default y

config DRM_ROCKCHIP_ANALOGIX_DP
	bool "Rockchip Analogix DP / eDP"
	default y
	select DRM_DP_HELPER

config DRM_ROCKCHIP_INNO_VIDEO_COMBO_PHY
	bool "Rockchip Inno Video Combo PHY"
	default y

endif
```
